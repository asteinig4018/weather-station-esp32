## components/web_server/Kconfig
```kconfig
menu "Web Server"
    depends on !HAL_USE_MOCK

    config WEB_SERVER_PORT
        int "HTTP server port"
        default 80
        range 1 65535
        help
            Port for the built-in HTTP server (status API + OTA push).

endmenu
```

## main/Kconfig.projbuild
```kconfig
menu "Weather Station"

    choice APP_MODE
        prompt "Application mode"
        default APP_MODE_DEBUG
        help
            Select the application mode.
            DEBUG runs a sequential hardware test on each peripheral.
            PRODUCTION runs the full sensor/display/network application.

        config APP_MODE_DEBUG
            bool "Debug (hardware test)"

        config APP_MODE_PRODUCTION
            bool "Production"
    endchoice

    config HAL_USE_MOCK
        bool "Use mock HAL backends (for QEMU / CI)"
        default n
        help
            Replace real hardware drivers with mock backends that return
            synthetic data. Enable this for QEMU testing, CI pipelines,
            or development without hardware connected.

            When enabled:
              - hal_sensors returns sine-wave / random sensor data
              - hal_display logs framebuffer content to UART
              - I2C bus init is skipped
              - Display parallel bus init is skipped

    menu "Network"
        depends on APP_MODE_PRODUCTION && !HAL_USE_MOCK

        config NET_WIFI_SSID
            string "WiFi SSID"
            default "my_wifi"
            help
                WiFi network name to connect to.

        config NET_WIFI_PASS
            string "WiFi password"
            default "my_password"
            help
                WiFi network password (WPA2-PSK).

        config NET_SERVER_URL
            string "Telemetry server URL"
            default "http://192.168.1.100:8080/api/telemetry"
            help
                HTTP endpoint for POSTing sensor data JSON.

        config NET_UPLOAD_INTERVAL_S
            int "Upload interval (seconds)"
            default 60
            range 10 3600
            help
                How often to upload sensor data to the server.

    endmenu

    menu "OTA Updates"
        depends on APP_MODE_PRODUCTION && !HAL_USE_MOCK

        config OTA_SERVER_URL
            string "OTA firmware URL"
            default "http://192.168.1.100:8080/firmware/weather_station.bin"
            help
                URL pointing to the firmware .bin file for OTA updates.

        config OTA_CHECK_INTERVAL_S
            int "OTA check interval (seconds)"
            default 3600
            range 60 86400
            help
                How often to check for firmware updates.

    endmenu

endmenu
```

## sdkconfig.defaults
```kconfig
# Default Kconfig overrides for weather_station
# Edit values here; do NOT commit sdkconfig itself.
#
# Re-apply after clean: idf.py set-target esp32s3

CONFIG_IDF_TARGET="esp32s3"

# CPU / power
CONFIG_ESP_DEFAULT_CPU_FREQ_MHZ_240=y

# Logging
CONFIG_LOG_DEFAULT_LEVEL_DEBUG=y

# Use native USB CDC for console (ESP32-S3 built-in USB)
CONFIG_ESP_CONSOLE_USB_CDC=y

# I2C driver (legacy driver; new driver is opt-in from IDF 5.x)
CONFIG_I2C_ENABLE_DEBUG_LOG=n

# LCD / parallel display
# The LCD_CAM peripheral is enabled by default on ESP32-S3.
# If you increase DMA transfer size, bump this:
# CONFIG_LCD_PANEL_IO_FORMAT_BUF_SIZE=512

# FreeRTOS
CONFIG_FREERTOS_HZ=1000
CONFIG_ESP_MAIN_TASK_STACK_SIZE=8192

# Flash: N8 = 8 MB SPI flash, Quad SPI
CONFIG_ESPTOOLPY_FLASHSIZE_8MB=y
CONFIG_PARTITION_TABLE_CUSTOM=y
CONFIG_PARTITION_TABLE_CUSTOM_FILENAME="partitions.csv"

# LVGL fonts
CONFIG_LV_FONT_MONTSERRAT_14=y
CONFIG_LV_FONT_MONTSERRAT_16=y
CONFIG_LV_FONT_MONTSERRAT_20=y
CONFIG_LV_COLOR_16_SWAP=y
CONFIG_LV_MEM_SIZE_KILOBYTES=48
```
